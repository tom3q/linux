## Documentation/devicetree/bindings/dma/arm-pl08x.txt
```
* ARM PrimeCell PL08x DMA Controllers

The ARM PrimeCell PL08x DMA controllers can move blocks of memory contents
between memory and peripherals or memory to memory.

Required properties:
  - compatible: should include two values:
    - one of following:
      - "arm,pl080" - for ARM PrimeCell PL080 DMA controller
      - "arm,pl081" - for ARM PrimeCell PL081 DMA controller
      - "arm,pl080s" - for Samsung-licensed ARM PL080s DMA controller
    - and also "arm,primecell".
  - reg: physical base address of the controller and length of memory mapped
    region.
  - interrupt-parent: phandle of interrupt controller,
  - interrupts: interrupt specifier specific to interrupt controller,
  - #dma-cells: must be <1>. used to represent the number of integer
    cells in the dmas property of client device

Optional proparties:
  - clock-names: must contain one entry - "apb_pclk",
  - clocks: must contain one clock specifier of DMA bus clock

Example:

	dma0: dma@75000000 {
		compatible = "arm,pl080s", "arm,primecell";
		reg = <0x75000000 0x1000>;
		interrupt-parent = <&vic1>;
		interrupts = <9>;
		clocks = <&clocks HCLK_DMA0>;
		clock-names = "apb_pclk";
		#dma-cells = <1>;
	};

Device nodes of client devices should use simple DMA specifier format, which
consists of two values:
 - phandle of DMA controller,
 - index of DMA channel.

Example:

	spi0: spi@7f00b000 {
		/* ,,, */
		dma-names = "tx", "rx";
		dmas = <&dma0 12>, <&dma0 13>;
		/* ... (/
	};
```

## Documentation/devicetree/bindings/input/touchscreen/atmel_mxt_ts.txt
```
* Atmel maXtouch touchscreen controller

Required properties:
- compatible: must be "atmel,maxtouch"
- reg: I2C address of the chip
- interrupt-parent: interrupt controller which provides the interrupt
- interrupts: interrupt signal to which the chip is connected
- atmel,x-line: horizonal line
- atmel,y-line: vertical line
- atmel,x-size: horizontal resolution of touchscreen
- atmel,y-size: vertical resolution of touchscreen
- atmel,burst-length: burst length
- atmel,threshold: threshold
- atmel,orientation: touchscreen orientation, must be one of following:
    - 0: normal
    - 1: diagonal
    - 2: horizonally flipped
    - 3: rotated by 90 degrees counter-clockwise
    - 4: vertically flipped
    - 5: rotated by 90 degress clockwise
    - 6: rotated by 180 degrees
    - 7: diagonal counter

Optional properties:
- vdd-supply: voltage regulator used for power control and reading
  operating voltage

Example:

	i2c@00000000 {
		/* ... */

		tsp@4a {
			compatible = "atmel,maxtouch";
			reg = <0x4a>;
			interrupt-parent = <&gpe1>;
			interrupts = <7 2>;

			atmel,x-line = <19>;
			atmel,y-line = <11>;
			atmel,x-size = <800>;
			atmel,y-size = <480>;
			atmel,burst-length = <0x11>;
			atmel,threshold = <0x28>;
			atmel,orientation = <1>;

			vdd-supply = <&tsp_reg>;
		};

		/* ... */
	};
```

## Documentation/devicetree/bindings/phy/samsung-phy.txt
```
Samsung S5P/EXYNOS SoC series MIPI CSIS/DSIM DPHY
-------------------------------------------------

Required properties:
- compatible : should be "samsung,s5pv210-mipi-video-phy";
- reg : offset and length of the MIPI DPHY register set;
- #phy-cells : from the generic phy bindings, must be 1;

For "samsung,s5pv210-mipi-video-phy" compatible PHYs the second cell in
the PHY specifier identifies the PHY and its meaning is as follows:
  0 - MIPI CSIS 0,
  1 - MIPI DSIM 0,
  2 - MIPI CSIS 1,
  3 - MIPI DSIM 1.

Samsung EXYNOS SoC series Display Port PHY
-------------------------------------------------

Required properties:
- compatible : should be "samsung,exynos5250-dp-video-phy";
- reg : offset and length of the Display Port PHY register set;
- #phy-cells : from the generic PHY bindings, must be 0;

Samsung S5P/EXYNOS SoC series USB PHY
-------------------------------------------------

Required properties:
- compatible : should be one of the listed compatibles:
	- "samsung,exynos4210-usb2-phy"
	- "samsung,exynos4212-usb2-phy"
- reg : a list of registers used by phy driver
	- first and obligatory is the location of phy modules registers
- samsung,sysreg-phandle - handle to syscon used to control the system registers
- samsung,pmureg-phandle - handle to syscon used to control PMU registers
- #phy-cells : from the generic phy bindings, must be 1;
- clocks and clock-names:
	- the "phy" clocks is required by the phy module
	- next for each of the phys a clock has to be assigned, this clock
	  will be used to determine clocking frequency for the phys
	  (the labels are specified in the paragraph below)

The first phandle argument in the PHY specifier identifies the PHY, its
meaning is compatible dependent. For the currently supported SoCs (Exynos 4210
and Exynos 4212) it is as follows:
  0 - USB device ("device"),
  1 - USB host ("host"),
  2 - HSIC0 ("hsic0"),
  3 - HSIC1 ("hsic1"),

Exynos 4210 and Exynos 4212 use mode switching and require that mode switch
register is supplied.

Example:

For Exynos 4412 (compatible with Exynos 4212):

usbphy: phy@125b0000 {
	compatible = "samsung,exynos4212-usb2-phy";
	reg = <0x125b0000 0x100 0x10020704 0x0c 0x1001021c 0x4>;
	clocks = <&clock 305>, <&clock 2>, <&clock 2>, <&clock 2>,
							<&clock 2>;
	clock-names = "phy", "device", "host", "hsic0", "hsic1";
	status = "okay";
	#phy-cells = <1>;
	samsung,sysreg-phandle = <&sys_reg>;
	samsung,pmureg-phandle = <&pmu_reg>;
};

Then the PHY can be used in other nodes such as:

phy-consumer@12340000 {
	phys = <&usbphy 2>;
	phy-names = "phy";
};

Refer to DT bindings documentation of particular PHY consumer devices for more
information about required PHYs and the way of specification.
```
